## config/boards/shields/JiyuJizai/Kconfig.defconfig
```kconfig
if SHIELD_JIYUJIZAI_R

config ZMK_KEYBOARD_NAME
    default "JiyuJizai_R"

config ZMK_SPLIT
    default y

config ZMK_SPLIT_ROLE_CENTRAL
    default y

endif

if SHIELD_JIYUJIZAI_L

config ZMK_KEYBOARD_NAME
    default "JiyuJizai_L"

config ZMK_SPLIT
    default y

endif
```

## config/boards/shields/JiyuJizai/Kconfig.shield
```kconfig
config SHIELD_JIYUJIZAI_R
    def_bool $(shields_list_contains,JiyuJizai_R)

config SHIELD_JIYUJIZAI_L
    def_bool $(shields_list_contains,JiyuJizai_L)
```

## config/west.yml
```yaml
manifest:
  remotes:
    - name: zmkfirmware
      url-base: https://github.com/zmkfirmware
    - name: shakushakupanda
      url-base: https://github.com/shakushakupanda
    - name: caksoylar  # <-- new entry
      url-base: https://github.com/caksoylar  
  projects:
    - name: zmk
      remote: zmkfirmware
      revision: v0.2
      import: app/west.yml
    - name: zmk-driver-paw3222
      remote: shakushakupanda
      revision: main
    - name: zmk-rgbled-widget  # <-- new entry
      remote: caksoylar
      revision: main
  self:
    path: config
```
